## Kconfig
```kconfig
menuconfig IQS5XX
    bool "IQS5XX Trackpad IC"
    default y
    depends on GPIO
    depends on I2C
    help
      Enable driver for IQS5XX based-trackpads with enhanced performance
      and gesture recognition capabilities.

if IQS5XX

config IQS5XX_GESTURE_PROCESSING
    bool "Enable advanced gesture processing"
    default y
    help
      Enable advanced gesture recognition including multi-finger gestures,
      swipe detection, and customizable gesture responses.

config IQS5XX_PERFORMANCE_OPTIMIZATION
    bool "Enable performance optimizations"
    default y
    help
      Enable performance optimizations including I2C caching,
      movement smoothing, and interrupt-driven processing.

config IQS5XX_DEBUG_STATS
    bool "Enable debug statistics"
    default n
    help
      Enable collection of performance and debugging statistics.
      Disable in production builds for optimal performance.

endif # IQS5XX
```

## dts/bindings/input/azoteq,iqs5xx.yaml
```yaml
description: |
  Sensor driver for the Azoteq IQS5XX trackpad IC
compatible: "azoteq,iqs5xx"

include: ["i2c-device.yaml"]

properties:
  dr-gpios:
    type: phandle-array
    required: true
    description: Data ready pin for the trackpad

  invert-x:
    type: boolean
    description: Invert X-axis movement

  invert-y:
    type: boolean
    description: Invert Y-axis movement

  rotate-90:
    type: boolean
    description: Rotate trackpad coordinates 90 degrees clockwise (x,y) → (y,-x).

  rotate-180:
    type: boolean
    description: Rotate trackpad coordinates 180 degrees (x,y) → (-x,-y).

  rotate-270:
    type: boolean
    description: Rotate trackpad coordinates 270 degrees clockwise (x,y) → (-y,x).

  no-taps:
    type: boolean
    description: Disable tap detection

  sensitivity:
    type: int
    default: 128
    minimum: 64
    maximum: 255
    description: Mouse sensitivity multiplier (64=slower, 128=normal, 255=faster)

  refresh-rate-active:
    type: int
    default: 5
    description: Active refresh rate in milliseconds

  refresh-rate-idle:
    type: int
    default: 20
    description: Idle refresh rate in milliseconds
```
