/dts-v1/;

/ {
	iqs5xx: iqs5xx@74 {
           compatible = "azoteq,iqs5xx";
           label = "AZOTEQ_IQS5XX";
           status = "okay";
           reg = <0x74>;
           dr-gpios = <&gpio1 4 GPIO_ACTIVE_HIGH>;
  };
};
